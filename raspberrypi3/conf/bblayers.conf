## raspberrypi3/conf/bblayers.conf
```bitbake
# POKY_BBLAYERS_CONF_VERSION is increased each time build/conf/bblayers.conf
# changes incompatibly
POKY_BBLAYERS_CONF_VERSION = "2"

BBPATH = "${TOPDIR}"
BBFILES ?= ""

BBLAYERS ?= " \
  /home/vidal/wkg/yocto-zeus-3.0/poky/meta \
  /home/vidal/wkg/yocto-zeus-3.0/poky/meta-poky \
  /home/vidal/wkg/yocto-zeus-3.0/poky/meta-yocto-bsp \
  /home/vidal/wkg/yocto-zeus-3.0/poky/meta-raspberrypi \
  /home/vidal/wkg/yocto-zeus-3.0/poky/meta-oe \
  /home/vidal/wkg/yocto-zeus-3.0/poky/meta-python \
  /home/vidal/wkg/yocto-zeus-3.0/poky/meta-multimedia \
  "
```
